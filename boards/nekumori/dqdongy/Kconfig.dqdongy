## boards/nekumori/dqdongy/Kconfig.dqdongy
```kconfig
# Copyright (c) 2018 Nordic Semiconductor ASA
# SPDX-License-Identifier: Apache-2.0

config BOARD_DQDONGY
	select SOC_NRF52833_QIAA
```

## west.yml
```yaml
manifest:
  version: "1.2"
  projects:

    # nRF-Connect SDK
    - name: sdk-nrf
      path: nrf
      url: https://github.com/nrfconnect/sdk-nrf.git
      revision: v3.1-branch
      import: true
      
    # SlimeVR-Tracker-nRF-Receiver
    - name: SlimeVR-Tracker-nRF-Receiver
      url: https://github.com/Dqmaged/SlimeVR-Tracker-nRF-Receiver.git
      path: SlimeVR-Tracker-nRF-Receiver
      revision: master
```
